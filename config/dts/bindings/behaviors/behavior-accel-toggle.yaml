## config/dts/bindings/behaviors/behavior-accel-toggle.yaml
```yaml
# config/dts/bindings/behaviors/behavior-accel-toggle.yaml

compatible: "zmk,behavior-accel-toggle"

description: Acceleration toggle behavior for paw32xx

#binding-cells:
  - dev_idx

properties: {}
```

## config/west.yml
```yaml
manifest:
  remotes:
    - name: zmkfirmware
      url-base: https://github.com/zmkfirmware
    - name: nuovotaka
      url-base: https://github.com/nuovotaka
  projects:
    - name: zmk
      remote: zmkfirmware
      revision: v0.3.0
      import: app/west.yml
    - name: zmk-driver-paw3222-alpha
      remote: nuovotaka
      revision: main
  self:
    path: config
```
